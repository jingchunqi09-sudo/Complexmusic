`timescale 1ns/1ps
//=============================================================================
// harmonic_osc_bank.v —— R62b 加法合成振荡器组（N 路并行独立振荡单元）
//
// ┌─────────────────────────────────────────────────────────────────────────┐
// │ 这个模块是什么（一句话）                                                │
// │   N 路各自独立的**加法合成振荡器**，输出叠加进主混音。每路都有独立的    │
// │   相位累加器、独立的频率、独立的包络 —— 即赛题定义的完整振荡器。        │
// └─────────────────────────────────────────────────────────────────────────┘
//
// ┌─────────────────────────────────────────────────────────────────────────┐
// │ 数据流（先看这张图，再看代码）                                          │
// │                                                                         │
// │  i_note[8][7] / i_gate[8] / i_env[8][16]                                │
// │            │                                                            │
// │            ▼      每样本 2N 拍 TDM（48 拍 / 1024 clk = 4.7%）           │
// │   ┌──────────────────┐                                                  │
// │   │ 相位累加器 ×N    │  24 位（R62b 由 32 位降下来）                    │
// │   └────────┬─────────┘                                                  │
// │            │ 相位高 10 位                                               │
// │   ┌────────▼─────────┐                                                  │
// │   │ 正弦表 1024×16   │  1 块 BSRAM，N 路分时读                          │
// │   └────────┬─────────┘                                                  │
// │   ┌────────▼─────────┐                                                  │
// │   │ × 包络（ADSR）   │  复用该弦的 voice_envelope，门控关则归零         │
// │   └────────┬─────────┘                                                  │
// │   ┌────────▼─────────┐                                                  │
// │   │ N 项累加 + 饱和  │                                                  │
// │   └────────┬─────────┘                                                  │
// │            ▼                                                            │
// │        o_sum[19:0]  ──►  instrument_bank_core 的 r_mix                  │
// └─────────────────────────────────────────────────────────────────────────┘
//
// ┌─────────────────────────────────────────────────────────────────────────┐
// │ 赛题依据（官方资料/赛题要求.pdf p15-16，选题二）                        │
// │   ·「吞吐量 = 同时活跃可闻独立振荡器总数 × 实际音频输出采样率」         │
// │   ·「加法合成按运算分量统计」                                           │
// │   · 拓展1：「复音数 ≥32，或单音加法合成分量 ≥32 路」                    │
// │                                                                         │
// │   24 路本模块 + 8 条物理建模弦 = 32 个独立单元                          │
// │   吞吐量 = 32 × 48,828.125 = 1,562,500 osc·Hz                           │
// └─────────────────────────────────────────────────────────────────────────┘
//
//=============================================================================
// 参数表（改之前先读"后果"）
//=============================================================================
//  INC_SCALE      = 87961   = 2^32 / 48828.125。改采样率必须同步改这个数。
//                           改小 → 全部音高偏低；改大 → 偏高。
//  N_OSC          = 24      加法合成单元数。8 条弦 + 24 = 32 单元。
//                           必须是 8 的倍数（单元→弦的映射靠位选，见第 4 节）。
//                           改大会线性增加相位寄存器（N×24 FF）与 mux 宽度。
//  AMP_SHIFT_RUN  = 5       演奏档每路 -30 dB。改大更轻（6 = -36 dB）。
//  AMP_SHIFT_TEST = 3       测试档每路 -18 dB，供频谱数谱峰。
//  TEST_BASE      = 36      测试模式起始音（C2）；第 i 路 = BASE + 3i。
//
//=============================================================================
// 三段 TDM 的排法，以及为什么这样排
//=============================================================================
//  每样本 2N 拍（N=24 → 48 拍）
//    slot 0   .. N-1    地址阶段：发正弦表地址（相位高 10 位）+ 重算相位增量
//    slot N   .. 2N-1   取数阶段：读回正弦值、乘包络、累加、推进该路相位
//
//  为什么取数要倒序：BSRAM 是同步读，第 k 拍发出的地址要到 k+1 拍才出数据。
//  地址阶段共 N 拍，所以取数阶段第 0 拍拿到的是地址阶段最后一拍（idx=N-1）
//  发出的地址 → idx = 2N-1-slot。这个映射不需要任何额外寄存器。
//
//=============================================================================
// 单元 → 弦 / 泛音（零成本，全靠位选）
//=============================================================================
//  N = 8 弦 × 3 泛音：
//      idx[2:0] = 弦号 lane (0..7)
//      idx[4:3] = 泛音序号 0/1/2
//      泛音比：0 → ×2（八度）  1 → ×3（十二度）  2 → ×4（两个八度）
//  演奏时每根弦自动得到 3 个泛音分量；测试模式则每路用独立固定音高。
//
//=============================================================================
// 关键约束（不可违反）
//=============================================================================
//  输入一律取 audio_core **内部寄存器**（r_note / r_gate / w_envelope），
//  不从顶层 note_bus / gate_bus 取。R44 / R57 两次事故都是给顶层关键信号
//  加消费者导致布局漂移、实板乱响。
//=============================================================================
module harmonic_osc_bank #(
    parameter integer INC_SCALE      = 87961,   // 2^32 / fs
    parameter integer N_OSC          = 24,      // 加法合成单元数
    parameter integer AMP_SHIFT_RUN  = 5,       // 演奏档 -30 dB
    parameter integer AMP_SHIFT_TEST = 3,       // 测试档 -18 dB
    parameter [6:0]   TEST_BASE      = 7'd36    // C2
)(
    input  wire         clk,
    input  wire         reset,
    input  wire         sample_tick,            // 每音频样本一次
    input  wire [55:0]  i_note,                 // 8 x 7 bit MIDI
    input  wire [7:0]   i_gate,                 // 8 路门控
    input  wire [127:0] i_env,                  // 8 x 16 bit 包络
    input  wire         i_test_mode,
    output reg  signed [19:0] o_sum,            // N 路合计（已饱和）
    output reg          o_valid
);
    // note_hz 是全局 function，必须在 module 作用域内 include
    // （Verilog-2001 不允许 module 外的全局声明；放文件顶部会报 vlog-2155）。
    `include "r9_note_hz.vh"

    //-------------------------------------------------------------------------
    // 0. 尺寸常量
    //-------------------------------------------------------------------------
    // Verilog-2001 没有 $clog2，用条件表达式给出位宽；integer parameter 不能
    // 位选，所以要用到的几个值先落成定宽 localparam。
    localparam integer SLOTS     = 2 * N_OSC;                        // 48
    localparam integer IDX_W     = (N_OSC <= 16) ? 5 : (N_OSC <= 32) ? 6 : 7;
    localparam integer SLOT_W    = (SLOTS  <= 16) ? 5 : (SLOTS  <= 32) ? 6 : (SLOTS <= 64) ? 7 : 8;
    localparam integer LAST_SLOT = SLOTS - 1;
    localparam [SLOT_W-1:0] FIRST_FETCH_SLOT = N_OSC;        // 直接赋值即截断
    localparam [SLOT_W-1:0] LAST_SLOT_CONST = LAST_SLOT;
    localparam [IDX_W-1:0]  IDX_ZERO = {IDX_W{1'b0}};

    // R62b：相位/增量 32 → 24 位。
    //   频率分辨率 = fs / 2^24 = 48828.125 / 16777216 = 0.0029 Hz，远小于人耳
    //   可辨的 1 音分（A4 上约 0.26 Hz），音准无损。
    //   省下 24 路 × 2 个数组 × 8 位 = 384 个触发器，mux 宽度也窄 25%。
    localparam integer PW = 24;                      // 相位字长

    //-------------------------------------------------------------------------
    // 1. 正弦表（1 块 BSRAM）
    //-------------------------------------------------------------------------
    // 1024 点、16 位有符号、满幅 32767。由 scripts/gen_sine_rom.py 生成。
    // 不做插值：48.8 kHz 下 1024 点表在 2 kHz 以内的量化误差优于 -60 dB，
    // 配 -18 dB 的泛音层完全够。
    reg signed [15:0] sine_rom [0:1023];
    initial begin
        $readmemh("src/rom/sine_1024x16.hex", sine_rom);
    end

    //-------------------------------------------------------------------------
    // 2. 每路状态
    //-------------------------------------------------------------------------
    reg  [PW-1:0]      r_phase  [0:N_OSC-1];   // 独立相位累加器
    reg  [PW-1:0]      r_inc    [0:N_OSC-1];   // 独立频率增量（音高变化时才重算）
    reg  [6:0]         r_note_prev [0:N_OSC-1];   // 上一次的音符
    reg  [SLOT_W-1:0]  r_slot;                 // TDM 拍号 0..SLOTS-1
    reg  [9:0]         r_addr;                 // 正弦表地址
    reg  signed [15:0] r_sine_r1;               // BSRAM 输出（晚 1 拍）
    reg  signed [21:0] r_acc;                  // N 项累加器

    //-------------------------------------------------------------------------
    // 3. TDM 索引
    //-------------------------------------------------------------------------
    // 地址阶段用 slot 本身；取数阶段用**完整 slot 值**做倒序减法，
    // 不能取低位：slot 32..47 的低 5 位会回绕成 0..15，索引就全错。
    wire             fetch_ph   = (r_slot >= FIRST_FETCH_SLOT);          // 1 = 取数阶段
    wire [IDX_W-1:0] addr_idx   = r_slot[IDX_W-1:0];             // 0..N-1
    wire [SLOT_W-1:0] fetch_rev = LAST_SLOT_CONST - r_slot;             // 2N-1-slot
    wire [IDX_W-1:0]  fetch_idx = fetch_rev[IDX_W-1:0];

    //-------------------------------------------------------------------------
    // 4. 单元 → 弦 / 泛音（位选，零成本）
    //-------------------------------------------------------------------------
    wire [1:0] osc_harm = addr_idx[IDX_W-1:3];                   // 0/1/2

    //-------------------------------------------------------------------------
    // 5. 音高 → 相位增量
    //-------------------------------------------------------------------------
    // 测试模式：第 i 路 = TEST_BASE + 3i，24 路互不相同（频谱可见 24 个谱峰）。
    // 演奏模式：跟随该路所属弦的当前音高。
    wire [6:0]  test_note = TEST_BASE + ({1'b0, addr_idx} * 7'd3);
    wire [6:0]  run_note  = i_note[addr_idx[2:0]*7 +: 7];
    wire [6:0]  cur_note  = i_test_mode ? test_note : run_note;
    wire [15:0] cur_hz    = note_hz(cur_note);

    // 基波相位增量
    //   Q32: inc32 = hz × INC_SCALE，INC_SCALE = 2^32 / fs
    //   R62b 用 24 位相位，故右移 8 位得到 Q24 增量。
    //   精度验证：A4 440 Hz → inc32 = 440 × 87961 = 38,702,840，>>8 = 151,183；
    //   理论值 440 × 2^24 / 48828.125 = 151,182.7 —— 相对误差 2e-6，可忽略。
    //
    //   位宽说明：INC_SCALE 是 integer（32 位），直接参与乘法会让综合器生成
    //   32×32 乘法器。这里先收成 17 位常量（87961 < 2^17），乘法变成 16×17，
    //   DSP 用量与组合逻辑都降一档。
    localparam [16:0] SCALE_Q = INC_SCALE;
    wire [32:0]   inc_q32  = cur_hz * SCALE_Q;
    wire [PW-1:0] inc_base = inc_q32[PW+7:8];

    //-------------------------------------------------------------------------
    // 6. 泛音比（×2 / ×3 / ×4），全部移位+加法，无乘法器
    //-------------------------------------------------------------------------
    // 位宽取 PW+2：×3 / ×4 在极端增量下需要 PW+2 位，截断会让高音偏低。
    // 每一项都显式补齐到 PW+2，避免隐式扩展带来的位宽歧义。
    wire [PW+1:0] inc_x2   = {1'b0, inc_base, 1'b0};                                  // ×2
    wire [PW+1:0] inc_x3   = {{2{1'b0}}, inc_base} + {{1{1'b0}}, inc_base, 1'b0};      // base + 2*base
    wire [PW+1:0] inc_x4   = {inc_base, 2'b00};                                       // ×4
    wire [PW+1:0] inc_pick = (osc_harm == 2'd0) ? inc_x2 :
                             (osc_harm == 2'd1) ? inc_x3 : inc_x4;
    wire [PW-1:0] inc_value = inc_pick[PW-1:0];

    //-------------------------------------------------------------------------
    // 7. 取表 → 乘包络 → 累加
    //-------------------------------------------------------------------------
    wire [2:0] fetch_lane = fetch_idx[2:0];
    // 门控关时该路贡献 0：不给静音弦叠泛音，也不给未演奏的弦加噪底。
    wire [15:0]        fetch_env  = i_gate[fetch_lane] ? i_env[fetch_lane*16 +: 16] : 16'd0;
    wire signed [16:0] env_signed = $signed({1'b0, fetch_env});
    // Q15（正弦）× Q16（包络）= Q31，取 bit31..16 折回 Q15
    wire signed [32:0] amp_product = r_sine_r1 * env_signed;
    wire signed [15:0] amp_full    = $signed(amp_product[31:16]);
    // 两条幅度用**常量移位 + mux**，不用变量移位（变量移位会综合成桶形移位器）。
    wire signed [15:0] amp_scaled  = i_test_mode ? (amp_full >>> AMP_SHIFT_TEST)
                                                 : (amp_full >>> AMP_SHIFT_RUN);
    wire signed [21:0] amp_term    = {{6{amp_scaled[15]}}, amp_scaled};
    wire signed [21:0] acc_next    = r_acc + amp_term;

    //-------------------------------------------------------------------------
    // 8. 饱和（防止 N 路叠加溢出 20 位）
    //-------------------------------------------------------------------------
    function signed [19:0] sat20;
        input signed [21:0] v;
        begin
            if (v > 22'sd524287)       sat20 = 20'sd524287;
            else if (v < -22'sd524288) sat20 = -20'sd524288;
            else                        sat20 = v[19:0];
        end
    endfunction

    //-------------------------------------------------------------------------
    // 9. 主状态机：每样本跑一遍 2N 拍
    //-------------------------------------------------------------------------
    integer i;
    always @(posedge clk) begin
        if (reset) begin
            r_slot   <= {SLOT_W{1'b0}};
            r_addr   <= 10'd0;
            r_sine_r1 <= 16'sd0;
            r_acc    <= 22'sd0;
            o_sum    <= 20'sd0;
            o_valid  <= 1'b0;
            for (i = 0; i < N_OSC; i = i + 1) begin
                r_phase[i]  <= {PW{1'b0}};
                r_inc[i]    <= {PW{1'b0}};
                r_note_prev[i] <= 7'd0;
            end
        end else begin
            o_valid <= 1'b0;

            // BSRAM 同步读：每拍一次，地址来自 r_addr（地址阶段更新）
            r_sine_r1 <= sine_rom[r_addr];

            if (sample_tick) begin
                // 新样本：清累加器，从 slot 0 起跑
                r_slot <= {SLOT_W{1'b0}};
                r_acc  <= 22'sd0;
            end else begin
                // 计数器停在最后一拍，等下个 sample_tick。不饱和的话计数器会
                // 绕回 0 再跑一圈，累加器把同一批样本加两遍（输出翻倍）。
                //
                // ！！停止条件只能管计数器，不能连逻辑一起跳过。
                //   初版写成 `else if (r_slot != LAST) begin ... end`，结果
                //   最后一拍的「发布 o_sum」也被跳过 → o_sum 恒 0 → 综合器把
                //   整个模块当死逻辑扫掉（Gowin WARN NL0002 "swept in optimizing"），
                //   资源表里根本看不到这个模块。R57 是同一类教训：
                //   **改了代码不等于改了网表，必须回读综合日志确认模块还在。**
                if (r_slot != LAST_SLOT_CONST) r_slot <= r_slot + 1'b1;

                if (!fetch_ph) begin
                    // ---- 地址阶段 ----
                    r_addr <= r_phase[addr_idx][PW-1:PW-10];
                    // 音高变化时才重算增量：弦音高在一次按品期间不变，
                    // 每样本重算没有意义。
                    if (cur_note != r_note_prev[addr_idx]) begin
                        r_inc[addr_idx]    <= inc_value;
                        r_note_prev[addr_idx] <= cur_note;
                    end
                end else begin
                    // ---- 取数阶段 ----
                    r_acc <= acc_next;
                    r_phase[fetch_idx] <= r_phase[fetch_idx] + r_inc[fetch_idx];
                    if (fetch_idx == IDX_ZERO) begin
                        // 第 N 项已经包含在 acc_next 里，这里直接发布
                        o_sum   <= sat20(acc_next);
                        o_valid <= 1'b1;
                    end
                end
            end
        end
    end
endmodule
